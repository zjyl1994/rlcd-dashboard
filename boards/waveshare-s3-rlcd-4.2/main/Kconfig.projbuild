## boards/waveshare-s3-rlcd-4.2/main/Kconfig.projbuild
```kconfig
menu "Dashboard Configuration"

    config RLCD_PRODUCTION_BUILD
        bool "Production build mode"
        default n
        help
            Enable production power-saving behavior such as automatic light sleep.
            Keep this disabled during development to preserve a stable USB flashing/debug link.

    config WIFI_SSID
        string "WiFi SSID"
        default ""
        help
            Pre-configured WiFi SSID. Leave empty to use provisioning.

    config WIFI_PASSWORD
        string "WiFi Password"
        default ""
        help
            Pre-configured WiFi password.

    config LONG_PRESS_MS
        int "BOOT button long press time (ms)"
        default 3000
        help
            Duration in milliseconds for BOOT button long press to trigger re-provisioning.

    config NTP_SYNC_INTERVAL_MIN
        int "NTP re-sync interval (minutes)"
        default 720
        help
            Interval in minutes between NTP time syncs.

endmenu
```

## boards/waveshare-s3-rlcd-4.2/sdkconfig.defaults
```kconfig
# ESP32-S3-RLCD-4.2 Dashboard
CONFIG_IDF_TARGET="esp32s3"
CONFIG_ESPTOOLPY_FLASHMODE_QIO=y
CONFIG_ESPTOOLPY_FLASHSIZE_16MB=y
CONFIG_PARTITION_TABLE_CUSTOM=y
CONFIG_HTTPD_MAX_REQ_HDR_LEN=512
CONFIG_SPIRAM=y
CONFIG_SPIRAM_MODE_OCT=y
CONFIG_SPIRAM_SPEED_80M=y
CONFIG_FATFS_LFN_HEAP=y
CONFIG_FREERTOS_HZ=1000
CONFIG_ESP_DEFAULT_CPU_FREQ_MHZ_80=y
CONFIG_PM_ENABLE=y
CONFIG_FREERTOS_USE_TICKLESS_IDLE=y
CONFIG_FREERTOS_IDLE_TIME_BEFORE_SLEEP=3
CONFIG_LV_USE_CLIB_MALLOC=y
CONFIG_LV_USE_CLIB_STRING=y
CONFIG_LV_FONT_MONTSERRAT_12=y
CONFIG_LV_FONT_MONTSERRAT_14=y
CONFIG_LV_FONT_MONTSERRAT_16=y
CONFIG_LV_FONT_MONTSERRAT_24=y
CONFIG_LV_FONT_MONTSERRAT_48=y
CONFIG_LV_USE_TINY_TTF=y
CONFIG_LV_TINY_TTF_CACHE_GLYPH_CNT=256
CONFIG_HTTPD_TASK_STACK_SIZE=8192
CONFIG_ESP_SYSTEM_EVENT_TASK_STACK_SIZE=4096
CONFIG_SPIRAM_ALLOW_BSS_SEG_EXTERNAL_MEMORY=y
```
